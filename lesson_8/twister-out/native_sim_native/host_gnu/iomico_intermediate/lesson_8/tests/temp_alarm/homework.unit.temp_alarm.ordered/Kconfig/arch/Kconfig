## lesson_8/twister-out/native_sim_native/host_gnu/iomico_intermediate/lesson_8/tests/temp_alarm/homework.unit.temp_alarm.ordered/Kconfig/arch/Kconfig
```kconfig
# Load Zephyr Arch Kconfig descriptions.
osource "/home/ivan/projects/zephyr_workbench/deps/zephyr/arch/rx/Kconfig"
osource "/home/ivan/projects/zephyr_workbench/deps/zephyr/arch/x86/Kconfig"
osource "/home/ivan/projects/zephyr_workbench/deps/zephyr/arch/xtensa/Kconfig"
osource "/home/ivan/projects/zephyr_workbench/deps/zephyr/arch/sparc/Kconfig"
osource "/home/ivan/projects/zephyr_workbench/deps/zephyr/arch/riscv/Kconfig"
osource "/home/ivan/projects/zephyr_workbench/deps/zephyr/arch/posix/Kconfig"
osource "/home/ivan/projects/zephyr_workbench/deps/zephyr/arch/openrisc/Kconfig"
osource "/home/ivan/projects/zephyr_workbench/deps/zephyr/arch/mips/Kconfig"
osource "/home/ivan/projects/zephyr_workbench/deps/zephyr/arch/arm64/Kconfig"
osource "/home/ivan/projects/zephyr_workbench/deps/zephyr/arch/arm/Kconfig"
osource "/home/ivan/projects/zephyr_workbench/deps/zephyr/arch/arc/Kconfig"
```

## lesson_8/twister-out/native_sim_native/host_gnu/iomico_intermediate/lesson_8/tests/temp_alarm/homework.unit.temp_alarm.ordered/Kconfig/boards/Kconfig.defconfig.tmp
```kconfig
# Load Zephyr board defconfig descriptions.
osource "/home/ivan/projects/zephyr_workbench/deps/zephyr/boards/native/native_sim/Kconfig.defconfig"
```

## lesson_8/twister-out/native_sim_native/host_gnu/iomico_intermediate/lesson_8/tests/temp_alarm/homework.unit.temp_alarm.ordered/Kconfig/boards/Kconfig.tmp
```kconfig
# Load Zephyr board Kconfig descriptions.
osource "/home/ivan/projects/zephyr_workbench/deps/zephyr/boards/native/native_sim/Kconfig"
```

## lesson_8/twister-out/native_sim_native/host_gnu/iomico_intermediate/lesson_8/tests/temp_alarm/homework.unit.temp_alarm.ordered/Kconfig/soc/Kconfig.tmp
```kconfig
# Load Zephyr SoC Kconfig descriptions.
osource "/home/ivan/projects/zephyr_workbench/deps/zephyr/soc/xlnx/zynqmp/Kconfig"
osource "/home/ivan/projects/zephyr_workbench/deps/zephyr/soc/xlnx/zynq7000/Kconfig"
osource "/home/ivan/projects/zephyr_workbench/deps/zephyr/soc/xlnx/versalnet/Kconfig"
osource "/home/ivan/projects/zephyr_workbench/deps/zephyr/soc/xlnx/versal2/Kconfig"
osource "/home/ivan/projects/zephyr_workbench/deps/zephyr/soc/xlnx/versal/Kconfig"
osource "/home/ivan/projects/zephyr_workbench/deps/zephyr/soc/xen/Kconfig"
osource "/home/ivan/projects/zephyr_workbench/deps/zephyr/soc/wch/ch32v/Kconfig"
osource "/home/ivan/projects/zephyr_workbench/deps/zephyr/soc/ti/simplelink/Kconfig"
osource "/home/ivan/projects/zephyr_workbench/deps/zephyr/soc/ti/mspm0/Kconfig"
osource "/home/ivan/projects/zephyr_workbench/deps/zephyr/soc/ti/lm3s6965/Kconfig"
osource "/home/ivan/projects/zephyr_workbench/deps/zephyr/soc/ti/k3/Kconfig"
osource "/home/ivan/projects/zephyr_workbench/deps/zephyr/soc/telink/tlsr/Kconfig"
osource "/home/ivan/projects/zephyr_workbench/deps/zephyr/soc/syna/sr100/Kconfig"
osource "/home/ivan/projects/zephyr_workbench/deps/zephyr/soc/starfive/jh71xx/Kconfig"
osource "/home/ivan/projects/zephyr_workbench/deps/zephyr/soc/st/stm32/Kconfig"
osource "/home/ivan/projects/zephyr_workbench/deps/zephyr/soc/snps/qemu_arc/Kconfig"
osource "/home/ivan/projects/zephyr_workbench/deps/zephyr/soc/snps/nsim/arc_v/Kconfig"
osource "/home/ivan/projects/zephyr_workbench/deps/zephyr/soc/snps/nsim/arc_classic/Kconfig"
osource "/home/ivan/projects/zephyr_workbench/deps/zephyr/soc/snps/hsdk4xd/Kconfig"
osource "/home/ivan/projects/zephyr_workbench/deps/zephyr/soc/snps/hsdk/Kconfig"
osource "/home/ivan/projects/zephyr_workbench/deps/zephyr/soc/snps/emsk/Kconfig"
osource "/home/ivan/projects/zephyr_workbench/deps/zephyr/soc/snps/emsdp/Kconfig"
osource "/home/ivan/projects/zephyr_workbench/deps/zephyr/soc/snps/arc_iot/Kconfig"
osource "/home/ivan/projects/zephyr_workbench/deps/zephyr/soc/silabs/Kconfig"
osource "/home/ivan/projects/zephyr_workbench/deps/zephyr/soc/sifli/sf32/Kconfig"
osource "/home/ivan/projects/zephyr_workbench/deps/zephyr/soc/sifive/sifive_freedom/Kconfig"
osource "/home/ivan/projects/zephyr_workbench/deps/zephyr/soc/sensry/Kconfig"
osource "/home/ivan/projects/zephyr_workbench/deps/zephyr/soc/rockchip/Kconfig"
osource "/home/ivan/projects/zephyr_workbench/deps/zephyr/soc/renode/riscv_virtual/Kconfig"
osource "/home/ivan/projects/zephyr_workbench/deps/zephyr/soc/renode/cortex_r8_virtual/Kconfig"
osource "/home/ivan/projects/zephyr_workbench/deps/zephyr/soc/renesas/smartbond/Kconfig"
osource "/home/ivan/projects/zephyr_workbench/deps/zephyr/soc/renesas/rz/Kconfig"
osource "/home/ivan/projects/zephyr_workbench/deps/zephyr/soc/renesas/rx/Kconfig"
osource "/home/ivan/projects/zephyr_workbench/deps/zephyr/soc/renesas/rcar/Kconfig"
osource "/home/ivan/projects/zephyr_workbench/deps/zephyr/soc/renesas/ra/Kconfig"
osource "/home/ivan/projects/zephyr_workbench/deps/zephyr/soc/realtek/fingerprint/Kconfig"
osource "/home/ivan/projects/zephyr_workbench/deps/zephyr/soc/realtek/ec/Kconfig"
osource "/home/ivan/projects/zephyr_workbench/deps/zephyr/soc/realtek/bee/Kconfig"
osource "/home/ivan/projects/zephyr_workbench/deps/zephyr/soc/realtek/ameba/Kconfig"
osource "/home/ivan/projects/zephyr_workbench/deps/zephyr/soc/raspberrypi/rpi_pico/Kconfig"
osource "/home/ivan/projects/zephyr_workbench/deps/zephyr/soc/quicklogic/eos_s3/Kconfig"
osource "/home/ivan/projects/zephyr_workbench/deps/zephyr/soc/qemu/virt_riscv/Kconfig"
osource "/home/ivan/projects/zephyr_workbench/deps/zephyr/soc/qemu/or1k/Kconfig"
osource "/home/ivan/projects/zephyr_workbench/deps/zephyr/soc/qemu/malta/Kconfig"
osource "/home/ivan/projects/zephyr_workbench/deps/zephyr/soc/openisa/rv32m1/Kconfig"
osource "/home/ivan/projects/zephyr_workbench/deps/zephyr/soc/openhwgroup/cva6/Kconfig"
osource "/home/ivan/projects/zephyr_workbench/deps/zephyr/soc/oct/osd32mp15x/Kconfig"
osource "/home/ivan/projects/zephyr_workbench/deps/zephyr/soc/nxp/s32/Kconfig"
osource "/home/ivan/projects/zephyr_workbench/deps/zephyr/soc/nxp/rw/Kconfig"
osource "/home/ivan/projects/zephyr_workbench/deps/zephyr/soc/nxp/mcx/Kconfig"
osource "/home/ivan/projects/zephyr_workbench/deps/zephyr/soc/nxp/lpc/Kconfig"
osource "/home/ivan/projects/zephyr_workbench/deps/zephyr/soc/nxp/layerscape/Kconfig"
osource "/home/ivan/projects/zephyr_workbench/deps/zephyr/soc/nxp/kinetis/Kconfig"
osource "/home/ivan/projects/zephyr_workbench/deps/zephyr/soc/nxp/imxrt/Kconfig"
osource "/home/ivan/projects/zephyr_workbench/deps/zephyr/soc/nxp/imx/Kconfig"
osource "/home/ivan/projects/zephyr_workbench/deps/zephyr/soc/nuvoton/numicro/Kconfig"
osource "/home/ivan/projects/zephyr_workbench/deps/zephyr/soc/nuvoton/numaker/Kconfig"
osource "/home/ivan/projects/zephyr_workbench/deps/zephyr/soc/nuvoton/npcx/Kconfig"
osource "/home/ivan/projects/zephyr_workbench/deps/zephyr/soc/nuvoton/npcm/Kconfig"
osource "/home/ivan/projects/zephyr_workbench/deps/zephyr/soc/nordic/Kconfig"
osource "/home/ivan/projects/zephyr_workbench/deps/zephyr/soc/neorv32/Kconfig"
osource "/home/ivan/projects/zephyr_workbench/deps/zephyr/soc/native/inf_clock/Kconfig"
osource "/home/ivan/projects/zephyr_workbench/deps/zephyr/soc/microchip/sam/sama7/Kconfig"
osource "/home/ivan/projects/zephyr_workbench/deps/zephyr/soc/microchip/sam/sam_d5x_e5x/Kconfig"
osource "/home/ivan/projects/zephyr_workbench/deps/zephyr/soc/microchip/pic64/Kconfig"
osource "/home/ivan/projects/zephyr_workbench/deps/zephyr/soc/microchip/pic32c/pic32cz_ca/Kconfig"
osource "/home/ivan/projects/zephyr_workbench/deps/zephyr/soc/microchip/pic32c/pic32cx_sg/Kconfig"
osource "/home/ivan/projects/zephyr_workbench/deps/zephyr/soc/microchip/pic32c/pic32cm_pl/Kconfig"
osource "/home/ivan/projects/zephyr_workbench/deps/zephyr/soc/microchip/pic32c/pic32cm_jh/Kconfig"
osource "/home/ivan/projects/zephyr_workbench/deps/zephyr/soc/microchip/miv/Kconfig"
osource "/home/ivan/projects/zephyr_workbench/deps/zephyr/soc/microchip/mec/Kconfig"
osource "/home/ivan/projects/zephyr_workbench/deps/zephyr/soc/mediatek/mt8xxx/Kconfig"
osource "/home/ivan/projects/zephyr_workbench/deps/zephyr/soc/lowrisc/opentitan/Kconfig"
osource "/home/ivan/projects/zephyr_workbench/deps/zephyr/soc/litex/litex_vexriscv/Kconfig"
osource "/home/ivan/projects/zephyr_workbench/deps/zephyr/soc/ite/ec/Kconfig"
osource "/home/ivan/projects/zephyr_workbench/deps/zephyr/soc/intel/wildcat_lake/Kconfig"
osource "/home/ivan/projects/zephyr_workbench/deps/zephyr/soc/intel/raptor_lake/Kconfig"
osource "/home/ivan/projects/zephyr_workbench/deps/zephyr/soc/intel/panther_lake/Kconfig"
osource "/home/ivan/projects/zephyr_workbench/deps/zephyr/soc/intel/lakemont/Kconfig"
osource "/home/ivan/projects/zephyr_workbench/deps/zephyr/soc/intel/intel_socfpga_std/Kconfig"
osource "/home/ivan/projects/zephyr_workbench/deps/zephyr/soc/intel/intel_socfpga/Kconfig"
osource "/home/ivan/projects/zephyr_workbench/deps/zephyr/soc/intel/intel_niosv/Kconfig"
osource "/home/ivan/projects/zephyr_workbench/deps/zephyr/soc/intel/intel_ish/Kconfig"
osource "/home/ivan/projects/zephyr_workbench/deps/zephyr/soc/intel/intel_adsp/Kconfig"
osource "/home/ivan/projects/zephyr_workbench/deps/zephyr/soc/intel/elkhart_lake/Kconfig"
osource "/home/ivan/projects/zephyr_workbench/deps/zephyr/soc/intel/atom/Kconfig"
osource "/home/ivan/projects/zephyr_workbench/deps/zephyr/soc/intel/apollo_lake/Kconfig"
osource "/home/ivan/projects/zephyr_workbench/deps/zephyr/soc/intel/alder_lake/Kconfig"
osource "/home/ivan/projects/zephyr_workbench/deps/zephyr/soc/infineon/psoc4/Kconfig"
osource "/home/ivan/projects/zephyr_workbench/deps/zephyr/soc/infineon/edge/Kconfig"
osource "/home/ivan/projects/zephyr_workbench/deps/zephyr/soc/infineon/cat3/Kconfig"
osource "/home/ivan/projects/zephyr_workbench/deps/zephyr/soc/infineon/cat1c/Kconfig"
osource "/home/ivan/projects/zephyr_workbench/deps/zephyr/soc/infineon/cat1b/Kconfig"
osource "/home/ivan/projects/zephyr_workbench/deps/zephyr/soc/infineon/cat1a/Kconfig"
osource "/home/ivan/projects/zephyr_workbench/deps/zephyr/soc/gd/gd32/Kconfig"
osource "/home/ivan/projects/zephyr_workbench/deps/zephyr/soc/gaisler/leon3/Kconfig"
osource "/home/ivan/projects/zephyr_workbench/deps/zephyr/soc/gaisler/gr716a/Kconfig"
osource "/home/ivan/projects/zephyr_workbench/deps/zephyr/soc/focaltech/Kconfig"
osource "/home/ivan/projects/zephyr_workbench/deps/zephyr/soc/espressif/Kconfig"
osource "/home/ivan/projects/zephyr_workbench/deps/zephyr/soc/ene/kb1200/Kconfig"
osource "/home/ivan/projects/zephyr_workbench/deps/zephyr/soc/ene/kb106x/Kconfig"
osource "/home/ivan/projects/zephyr_workbench/deps/zephyr/soc/elan/em32f967/Kconfig"
osource "/home/ivan/projects/zephyr_workbench/deps/zephyr/soc/egis/Kconfig"
osource "/home/ivan/projects/zephyr_workbench/deps/zephyr/soc/efinix/sapphire/Kconfig"
osource "/home/ivan/projects/zephyr_workbench/deps/zephyr/soc/cdns/xtensa_sample_controller/Kconfig"
osource "/home/ivan/projects/zephyr_workbench/deps/zephyr/soc/cdns/swerv/Kconfig"
osource "/home/ivan/projects/zephyr_workbench/deps/zephyr/soc/cdns/sample_controller32/Kconfig"
osource "/home/ivan/projects/zephyr_workbench/deps/zephyr/soc/cdns/dc233c/Kconfig"
osource "/home/ivan/projects/zephyr_workbench/deps/zephyr/soc/brcm/bcmvk/Kconfig"
osource "/home/ivan/projects/zephyr_workbench/deps/zephyr/soc/brcm/bcm2712/Kconfig"
osource "/home/ivan/projects/zephyr_workbench/deps/zephyr/soc/brcm/bcm2711/Kconfig"
osource "/home/ivan/projects/zephyr_workbench/deps/zephyr/soc/blackberry/qnxhv_vm/Kconfig"
osource "/home/ivan/projects/zephyr_workbench/deps/zephyr/soc/bflb/Kconfig"
osource "/home/ivan/projects/zephyr_workbench/deps/zephyr/soc/atmel/sam0/Kconfig"
osource "/home/ivan/projects/zephyr_workbench/deps/zephyr/soc/atmel/sam/Kconfig"
osource "/home/ivan/projects/zephyr_workbench/deps/zephyr/soc/aspeed/Kconfig"
osource "/home/ivan/projects/zephyr_workbench/deps/zephyr/soc/arm/Kconfig"
osource "/home/ivan/projects/zephyr_workbench/deps/zephyr/soc/arm/beetle/Kconfig"
osource "/home/ivan/projects/zephyr_workbench/deps/zephyr/soc/antmicro/myra/Kconfig"
osource "/home/ivan/projects/zephyr_workbench/deps/zephyr/soc/andestech/Kconfig"
osource "/home/ivan/projects/zephyr_workbench/deps/zephyr/soc/amd/acp_6_0/Kconfig"
osource "/home/ivan/projects/zephyr_workbench/deps/zephyr/soc/ambiq/Kconfig"
osource "/home/ivan/projects/zephyr_workbench/deps/zephyr/soc/allwinner/sun8i_h3/Kconfig"
osource "/home/ivan/projects/zephyr_workbench/deps/zephyr/soc/alif/ensemble/Kconfig"
osource "/home/ivan/projects/zephyr_workbench/deps/zephyr/soc/aesc/Kconfig"
osource "/home/ivan/projects/zephyr_workbench/deps/zephyr/soc/adi/max32/Kconfig"
```

## lesson_8/twister-out/native_sim_native/host_gnu/iomico_intermediate/lesson_8/tests/temp_alarm/homework.unit.temp_alarm/Kconfig/boards/Kconfig.native_sim
```kconfig
# Load board Kconfig descriptions.
osource "/home/ivan/projects/zephyr_workbench/deps/zephyr/boards/native/native_sim/Kconfig.native_sim"
```

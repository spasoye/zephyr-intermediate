## prj.conf
```kconfig
CONFIG_LOG=y
CONFIG_LOG_DEFAULT_LEVEL=3
CONFIG_LOG_MODE_DEFERRED=y
CONFIG_LOG_RATELIMIT=y
CONFIG_LOG_RATELIMIT_INTERVAL_MS=1000

CONFIG_THREAD_NAME=y
CONFIG_THREAD_MONITOR=y

CONFIG_SHELL=y
CONFIG_KERNEL_SHELL=y
CONFIG_SHELL_BACKEND_SERIAL=y
CONFIG_SHELL_LOG_BACKEND=y

CONFIG_INIT_STACKS=y
CONFIG_THREAD_STACK_INFO=y

CONFIG_SERIAL=y
CONFIG_CONSOLE=y
CONFIG_UART_CONSOLE=y

CONFIG_TRACING=y
CONFIG_TRACING_CTF=y
CONFIG_TRACING_SYNC=y
CONFIG_TRACING_PACKET_MAX_SIZE=64

CONFIG_MAIN_STACK_SIZE=2048
```

## boards/esp32s3_devkitc_esp32s3_procpu.conf
```kconfig
# ESP32-S3-DevKitC (procpu) settings for lesson_6, applied on top of prj.conf.

# on hardware send the CTF stream over the UART chosen as zephyr,tracing-uart (usb_serial).
CONFIG_TRACING_BACKEND_UART=y

# Debug-friendly code for stepping with GDB/OpenOCD
# CONFIG_DEBUG_OPTIMIZATIONS=y

# Lets OpenOCD (-rtos Zephyr) show Zephyr threads in GDB / VS Code
CONFIG_DEBUG_THREAD_INFO=y
```

## boards/esp32s3_devkitc_esp32s3_procpu.overlay
```dts
/*
 * ESP32-S3-DevKitC (procpu) overlay for lesson_6.
 *
 * Console + shell stay on uart0 ("UART" USB port, CP210x -> /dev/ttyUSB*).
 * CTF tracing goes to the built-in USB Serial/JTAG controller ("USB" port,
 * /dev/ttyACM*), the same cable used for JTAG debugging; both work at once.
 */

/ {
    chosen {
        zephyr,tracing-uart = &usb_serial;
	    zephyr,console = &uart0;
    };
};

&usb_serial {
    status = "okay";
};
```

## src/main.c
```c
#include <zephyr/kernel.h>
#include <zephyr/logging/log.h>
#include <zephyr/tracing/tracing.h>

LOG_MODULE_REGISTER(homework, LOG_LEVEL_INF);

#define STACK_SIZE            2048
#define CONTROL_PRIORITY         4
#define MAINTENANCE_PRIORITY     7
#define EVENT_PERIOD_MS        250
#define MAINTENANCE_LOAD_US  45000

/* Response-time guarantee: control starts within 10 ms of the event */
#define CONTROL_DEADLINE_US  10000

struct control_event {
    uint32_t seq;
    uint32_t ready_cyc;     /* hardware cycle counter when the event was queued */
};

K_MSGQ_DEFINE(control_queue, sizeof(struct control_event), 4, 4);
K_SEM_DEFINE(maintenance_start, 0, 1);

/* ================================================================== */
/*  Timer expiry: creates one control event                           */
/* ================================================================== */

static void event_timer_expiry(struct k_timer *timer)
{
    ARG_UNUSED(timer);

    static uint32_t seq;
    struct control_event event = {
        .seq = seq++,
        .ready_cyc = k_cycle_get_32(),
    };

    /* Timer expiry runs in interrupt context, so never wait here. */
    int ret = k_msgq_put(&control_queue, &event, K_NO_WAIT);

    if (ret != 0) {
        return;
    }

    /* Both threads become ready when the timer interrupt returns. */
    k_sem_give(&maintenance_start);

    /* TODO: Add an application trace event for this sequence. */
    sys_trace_named_event("control_event", event.seq, 0);
}

K_TIMER_DEFINE(event_timer, event_timer_expiry, NULL);

/* ================================================================== */
/*  Control thread                                                   */
/* ================================================================== */

static void control_fn(void *p1, void *p2, void *p3)
{
    ARG_UNUSED(p1); ARG_UNUSED(p2); ARG_UNUSED(p3);
    uint32_t processed = 0;
    uint32_t missed = 0;

    while (true) {
        struct control_event event;
        
        int ret = k_msgq_get(&control_queue, &event, K_FOREVER);

        if (ret != 0) {
            LOG_ERR("[CONTROL] receive failed: %d", ret);
            continue;
        }

        /* Unsigned subtraction stays correct across cycle counter wrap-around */
        uint32_t latency_us = k_cyc_to_us_floor32(k_cycle_get_32() - event.ready_cyc);

        processed++;
        if (latency_us > CONTROL_DEADLINE_US) {
            missed++;
            LOG_WRN_RATELIMIT("[CONTROL] deadline missed for seq=%u latency=%u us (missed %u/%u)", event.seq, latency_us, missed, processed);
        }
        else{
            LOG_INF_RATELIMIT("[CONTROL] deadline met for seq=%u (latency=%u us)", event.seq, latency_us);
        }

        sys_trace_named_event("control_done", event.seq, latency_us);
        /* TODO: Define a response-time guarantee. */
        /* TODO: Measure latency and count every deadline miss. */
        /* TODO: Rate-limit repeated warning messages. */
        /* TODO: Add an application trace event for completion. */
    }
}

/* ================================================================== */
/*  Background maintenance thread                                    */
/* ================================================================== */

static void maintenance_fn(void *p1, void *p2, void *p3)
{
    ARG_UNUSED(p1); ARG_UNUSED(p2); ARG_UNUSED(p3);

    while (true) {
        k_sem_take(&maintenance_start, K_FOREVER);

        /* This work is important, but it has no short deadline. */
        k_busy_wait(MAINTENANCE_LOAD_US);
    }
}

K_THREAD_DEFINE(control, STACK_SIZE, control_fn,
                NULL, NULL, NULL, CONTROL_PRIORITY, 0, 0);

K_THREAD_DEFINE(maintenance, STACK_SIZE, maintenance_fn,
                NULL, NULL, NULL, MAINTENANCE_PRIORITY, 0, 0);

int main(void)
{
    LOG_INF("=== L6 Homework: Runtime Investigation ===");
    LOG_INF("Control work must start within 10 ms");
    LOG_INF("Inspect, measure, trace, explain, and correct the delay");

    k_timer_start(&event_timer, K_MSEC(500), K_MSEC(EVENT_PERIOD_MS));

    return 0;
}
```

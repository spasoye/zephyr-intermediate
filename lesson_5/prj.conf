## prj.conf
```kconfig
CONFIG_LOG=y
CONFIG_ZBUS=y
CONFIG_ZBUS_MSG_SUBSCRIBER=y
CONFIG_ZBUS_MSG_SUBSCRIBER_NET_BUF_POOL_SIZE=32
CONFIG_THREAD_NAME=y
CONFIG_THREAD_ANALYZER=y

CONFIG_TASK_WDT=y
# CONFIG_WATCHDOG=y
```

## src/main.c
```c
#include <zephyr/kernel.h>
#include <zephyr/logging/log.h>
#include <zephyr/zbus/zbus.h>
#include <zephyr/debug/thread_analyzer.h>
#include <zephyr/task_wdt/task_wdt.h>
#include <zephyr/logging/log_ctrl.h>
#include <zephyr/sys/reboot.h>

LOG_MODULE_REGISTER(demo, LOG_LEVEL_DBG);

#define STACK_SIZE       2048
#define SENSOR_COUNT       32
#define SENSOR_PERIOD_MS  150
#define TEMP_ALARM_MC   27000

#define HEALTH_PERIOD_MS   100
#define QUEUE_WARN_PERCENT  75

/* ===================================================================*/
/*  consumer watchdog callback                                                 */
/* ===================================================================*/
static void consumer_wdt_cb(int channel_id, void *user_data)
{
    LOG_ERR("[WDT] channel=%d stuck, rebooting", channel_id);
    LOG_PANIC();

    sys_reboot(SYS_REBOOT_COLD);

}

/* ================================================================== */
/*  Shared channel message                                            */
/* ================================================================== */

struct sensor_data {
    int32_t temperature_mc;
    uint32_t timestamp_ms;
    uint8_t seq;
};

/* Forward declarations required before observer/channel definitions. */
static void display_listener_cb(const struct zbus_channel *chan);

/* ================================================================== */
/*  Observers                                                         */
/* ================================================================== */

ZBUS_LISTENER_DEFINE(display_lis, display_listener_cb);

/*
 * Logger is a message subscriber.
 * It receives message copies, not only channel notifications.
 */
ZBUS_SUBSCRIBER_DEFINE(consumer_sub, 8);

/* ================================================================== */
/*  Channel                                                           */
/* ================================================================== */

ZBUS_CHAN_DEFINE(sensor_chan, struct sensor_data,
                 NULL, NULL,
                 ZBUS_OBSERVERS(display_lis, consumer_sub),
                 ZBUS_MSG_INIT(.temperature_mc = 0,
                               .timestamp_ms = 0,
                               .seq = 0));

/* ================================================================== */
/*  Listener - synchronous observer                                   */
/* ================================================================== */

static void display_listener_cb(const struct zbus_channel *chan)
{
    const struct sensor_data *msg =
        (const struct sensor_data *)zbus_chan_const_msg(chan);

    /*
     * Listener runs in publisher context.
     * Keep it short. No blocking work here.
     */
    LOG_INF("[DISPLAY-LIS] thread=%s seq=%u temp=%d mC",
            k_thread_name_get(k_current_get()),
            msg->seq,
            msg->temperature_mc);
}

/* ================================================================== */
/*  Publisher                                                         */
/* ================================================================== */

static void sensor_thread_fn(void *p1, void *p2, void *p3)
{
    ARG_UNUSED(p1); ARG_UNUSED(p2); ARG_UNUSED(p3);

    k_thread_name_set(k_current_get(), "sensor");

    for (int i = 0; i < SENSOR_COUNT; i++) {
        struct sensor_data data = {
            .temperature_mc = 24000 + (i * 350),
            .timestamp_ms = k_uptime_get_32(),
            .seq = (uint8_t)i,
        };

        LOG_INF("[SENSOR] publish seq=%u temp=%d mC",
                data.seq,
                data.temperature_mc);

        int ret = zbus_chan_pub(&sensor_chan, &data, K_MSEC(100));
        if (ret != 0) {
            /* Queue overflow */
            LOG_WRN("[SENSOR] publish failed ret=%d", ret);
        }

        k_msleep(SENSOR_PERIOD_MS);
    }

    LOG_INF("[SENSOR] done");
}

/* ================================================================== */
/*  Message subscriber - consumer                                       */
/* ================================================================== */

static void consumer_thread_fn(void *p1, void *p2, void *p3)
{
    ARG_UNUSED(p1); ARG_UNUSED(p2); ARG_UNUSED(p3);

    int wdt_id = task_wdt_add(1000, consumer_wdt_cb, NULL);
    k_thread_name_set(k_current_get(), "consumer");

    const struct zbus_channel *chan;
    int received = 0;

    while (received < SENSOR_COUNT) {
        struct sensor_data msg;

        /*
         * Message subscribers receive a copy of the published message.
         * The slow logger will not reread the latest channel value.
         */
        int ret = zbus_sub_wait(&consumer_sub, &chan, K_MSEC(1500));
        if (ret != 0) {
            LOG_WRN("[CONSUMER-MSG] timeout ret=%d", ret);
            break;
        }

        ret = zbus_chan_read(chan, &msg, K_MSEC(100));
        if (ret != 0) {
            LOG_WRN("[CONSUMER] read failed ret=%d", ret);
            continue;
        }

        received++;

        LOG_INF("[CONSUMER-MSG] thread=%s seq=%u temp=%d latency=%ums",
                k_thread_name_get(k_current_get()),
                msg.seq,
                msg.temperature_mc,
                k_uptime_get_32() - msg.timestamp_ms);

        /* Demonstrate stuck thread after receiving 10 messages */
        // if (received == 30) {
        //     k_sleep(K_FOREVER);
        // }

        task_wdt_feed(wdt_id);

        /*
         * Slow consumer.
         * Message copies let it process old samples safely.
         */
        k_msleep(250);
    }

    /* Delete the watchdog timer for this thread */
    task_wdt_delete(wdt_id);

    LOG_INF("[CONSUMER-MSG] done received=%d", received);
}

/* ================================================================== */
/*  Subscriber - health-check thread                                  */
/* ================================================================== */
static void health_thread_fn(void *p1, void *p2, void *p3)
{
    ARG_UNUSED(p1); ARG_UNUSED(p2); ARG_UNUSED(p3);

    k_thread_name_set(k_current_get(), "health-check");

    struct k_msgq *q = (struct k_msgq *)consumer_sub.queue;
    bool warned = false;

    while (true) {
        uint32_t used = k_msgq_num_used_get(q);
        uint32_t capacity = k_msgq_num_free_get(q) + used;
        uint8_t percent = (used * 100) / capacity;

        if (percent >= QUEUE_WARN_PERCENT && !warned) {
            LOG_WRN("[HEALTH] alarm queue %u/%u (%u%%)",
                    used, capacity, percent);
            warned = true;
        } else if (percent < QUEUE_WARN_PERCENT) {
            warned = false;
        }

        k_msleep(HEALTH_PERIOD_MS);
    }
}

/* ================================================================== */
/*  Threads                                                           */
/* ================================================================== */

K_THREAD_DEFINE(sensor_thread, STACK_SIZE, sensor_thread_fn,
                NULL, NULL, NULL, 5, 0, 0);

K_THREAD_DEFINE(consumer_thread, STACK_SIZE, consumer_thread_fn,
                NULL, NULL, NULL, 6, 0, 0);

K_THREAD_DEFINE(health_thread, STACK_SIZE, health_thread_fn,
                NULL, NULL, NULL, 6, 0, 0);

/* ================================================================== */
/*  Main                                                              */
/* ================================================================== */

int main(void)
{
    int ret = task_wdt_init(NULL);

	if (ret != 0) {
		printk("task wdt init failure: %d\n", ret);
		return 0;
	}
    
    k_sleep(K_MSEC(500));

    thread_analyzer_print(0);
    LOG_INF("=== L5 Reliability under pressure ===");


    return 0;
}
```

## src/main copy.c
```c
#include <zephyr/kernel.h>
#include <zephyr/logging/log.h>
#include <zephyr/logging/log_ctrl.h>
#include <zephyr/zbus/zbus.h>
#include <zephyr/debug/thread_analyzer.h>
#include <zephyr/task_wdt/task_wdt.h>
#include <zephyr/device.h>
#include <zephyr/sys/reboot.h>

LOG_MODULE_REGISTER(demo, LOG_LEVEL_DBG);

#define STACK_SIZE       2048
#define SENSOR_COUNT       18
#define SENSOR_PERIOD_MS  150
#define TEMP_ALARM_MC   27000

/* Logger must feed its watchdog channel at least this often. */
#define LOGGER_WDT_TIMEOUT_MS 1000
/* Logger hangs after this many messages. Set to 0 to disable. */
#define LOGGER_STUCK_AFTER       5

/* Hardware watchdog used as fallback for the task watchdog, if present. */
static const struct device *const hw_wdt_dev =
    DEVICE_DT_GET_OR_NULL(DT_ALIAS(watchdog0));

/* ================================================================== */
/*  Shared channel message                                            */
/* ================================================================== */

struct sensor_data {
    int32_t temperature_mc;
    uint32_t timestamp_ms;
    uint8_t seq;
};

/* Forward declarations required before observer/channel definitions. */
static void display_listener_cb(const struct zbus_channel *chan);

/* ================================================================== */
/*  Observers                                                         */
/* ================================================================== */

ZBUS_LISTENER_DEFINE(display_lis, display_listener_cb);

/*
 * Logger is a message subscriber.
 * It receives message copies, not only channel notifications.
 */
ZBUS_MSG_SUBSCRIBER_DEFINE(logger_sub);

/*
 * Alarm is a regular subscriber.
 * It receives channel notifications and then reads the latest value.
 */
ZBUS_SUBSCRIBER_DEFINE(alarm_sub, 4);

/* ================================================================== */
/*  Channel                                                           */
/* ================================================================== */

ZBUS_CHAN_DEFINE(sensor_chan, struct sensor_data,
                 NULL, NULL,
                 ZBUS_OBSERVERS(display_lis, logger_sub, alarm_sub),
                 ZBUS_MSG_INIT(.temperature_mc = 0,
                               .timestamp_ms = 0,
                               .seq = 0));

/* ================================================================== */
/*  Listener - synchronous observer                                   */
/* ================================================================== */

static void display_listener_cb(const struct zbus_channel *chan)
{
    const struct sensor_data *msg =
        (const struct sensor_data *)zbus_chan_const_msg(chan);

    /*
     * Listener runs in publisher context.
     * Keep it short. No blocking work here.
     */
    LOG_INF("[DISPLAY-LIS] thread=%s seq=%u temp=%d mC",
            k_thread_name_get(k_current_get()),
            msg->seq,
            msg->temperature_mc);
}

/* ================================================================== */
/*  Publisher                                                         */
/* ================================================================== */

static void sensor_thread_fn(void *p1, void *p2, void *p3)
{
    ARG_UNUSED(p1); ARG_UNUSED(p2); ARG_UNUSED(p3);

    k_thread_name_set(k_current_get(), "sensor");

    for (int i = 0; i < SENSOR_COUNT; i++) {
        struct sensor_data data = {
            .temperature_mc = 24000 + (i * 350),
            .timestamp_ms = k_uptime_get_32(),
            .seq = (uint8_t)i,
        };

        LOG_INF("[SENSOR] publish seq=%u temp=%d mC",
                data.seq,
                data.temperature_mc);

        int ret = zbus_chan_pub(&sensor_chan, &data, K_MSEC(100));
        if (ret != 0) {
            LOG_WRN("[SENSOR] publish failed ret=%d", ret);
        }

        k_msleep(SENSOR_PERIOD_MS);
    }

    LOG_INF("[SENSOR] done");
}

/* ================================================================== */
/*  Message subscriber - logger                                       */
/* ================================================================== */

static void logger_wdt_cb(int channel_id, void *user_data)
{
    /*
     * Runs in timer ISR context.
     * Flush pending logs before the reset, otherwise they are lost.
     */
    LOG_ERR("[WDT] channel=%d thread=%s stuck, rebooting",
            channel_id,
            k_thread_name_get((k_tid_t)user_data));
    LOG_PANIC();

    sys_reboot(SYS_REBOOT_COLD);
}

static void logger_thread_fn(void *p1, void *p2, void *p3)
{
    ARG_UNUSED(p1); ARG_UNUSED(p2); ARG_UNUSED(p3);

    k_thread_name_set(k_current_get(), "logger");

    const struct zbus_channel *chan;
    int received = 0;

    int wdt_id = task_wdt_add(LOGGER_WDT_TIMEOUT_MS, logger_wdt_cb,
                              k_current_get());
    if (wdt_id < 0) {
        LOG_ERR("[LOGGER-MSG] task wdt add failed ret=%d", wdt_id);
        return;
    }

    while (received < SENSOR_COUNT) {
        struct sensor_data msg;

        /*
         * Message subscribers receive a copy of the published message.
         * The slow logger will not reread the latest channel value.
         */
        int ret = zbus_sub_wait_msg(&logger_sub, &chan, &msg, K_MSEC(1500));
        if (ret != 0) {
            LOG_WRN("[LOGGER-MSG] timeout ret=%d", ret);
            break;
        }

        received++;
        task_wdt_feed(wdt_id);

        LOG_INF("[LOGGER-MSG] thread=%s seq=%u temp=%d latency=%ums",
                k_thread_name_get(k_current_get()),
                msg.seq,
                msg.temperature_mc,
                k_uptime_get_32() - msg.timestamp_ms);

        if (LOGGER_STUCK_AFTER != 0 && received == LOGGER_STUCK_AFTER) {
            /*
             * Simulated stuck consumer.
             * Blocks forever and never feeds the watchdog again.
             */
            LOG_WRN("[LOGGER-MSG] simulating stuck consumer");
            k_sleep(K_FOREVER);
        }

        /*
         * Slow logger.
         * Message copies let it process old samples safely.
         */
        k_msleep(350);
    }

    task_wdt_delete(wdt_id);

    LOG_INF("[LOGGER-MSG] done received=%d", received);
}

/* ================================================================== */
/*  Subscriber - alarm                                                */
/* ================================================================== */

static void alarm_thread_fn(void *p1, void *p2, void *p3)
{
    ARG_UNUSED(p1); ARG_UNUSED(p2); ARG_UNUSED(p3);

    k_thread_name_set(k_current_get(), "alarm");

    const struct zbus_channel *chan;
    int alarms = 0;

    while (true) {
        int ret = zbus_sub_wait(&alarm_sub, &chan, K_MSEC(3000));
        if (ret != 0) {
            LOG_INF("[ALARM-SUB] timeout, done");
            break;
        }

        struct sensor_data msg;

        ret = zbus_chan_read(chan, &msg, K_MSEC(100));
        if (ret != 0) {
            LOG_WRN("[ALARM-SUB] read failed ret=%d", ret);
            continue;
        }

        if (msg.temperature_mc >= TEMP_ALARM_MC) {
            alarms++;

            LOG_WRN("[ALARM-SUB] HIGH TEMP seq=%u temp=%d mC alarms=%d",
                    msg.seq,
                    msg.temperature_mc,
                    alarms);
        } else {
            LOG_INF("[ALARM-SUB] ok seq=%u temp=%d mC",
                    msg.seq,
                    msg.temperature_mc);
        }
    }
}

/* ================================================================== */
/*  Threads                                                           */
/* ================================================================== */

K_THREAD_DEFINE(sensor_thread, STACK_SIZE, sensor_thread_fn,
                NULL, NULL, NULL, 5, 0, 0);

K_THREAD_DEFINE(logger_thread, STACK_SIZE, logger_thread_fn,
                NULL, NULL, NULL, 6, 0, 0);

// K_THREAD_DEFINE(alarm_thread, STACK_SIZE, alarm_thread_fn,
//                 NULL, NULL, NULL, 6, 0, 0);

/* ================================================================== */
/*  Main                                                              */
/* ================================================================== */

int main(void)
{
    int ret = task_wdt_init(hw_wdt_dev);

	if (ret != 0) {
		printk("task wdt init failure: %d\n", ret);
		return 0;
	}
    
    thread_analyzer_print(0);
    LOG_INF("=== L4 Demo 2: Zbus Pub-Sub ===");
    LOG_INF("sensor publishes every %dms", SENSOR_PERIOD_MS);
    LOG_INF("display listener runs in publisher context");
    LOG_INF("logger uses message subscriber copies");
    LOG_INF("alarm uses a regular subscriber");
    LOG_INF("alarm threshold: %d mC", TEMP_ALARM_MC);

    return 0;
}
```
